## src/soc/atheros/ar7240/Kconfig
```kconfig
#
# This file is part of the coreboot project.
#
# Copyright (C) 2014 Imagination Technologies
#
# This program is free software; you can redistribute it and/or
# modify it under the terms of the GNU General Public License as
# published by the Free Software Foundation; version 2 of
# the License.
#
# This program is distributed in the hope that it will be useful,
# but WITHOUT ANY WARRANTY; without even the implied warranty of
# MERCHANTABILITY or FITNESS FOR A PARTICULAR PURPOSE.  See the
# GNU General Public License for more details.
#
# You should have received a copy of the GNU General Public License
# along with this program; if not, write to the Free Software
# Foundation, Inc.
#

config CPU_ATHEROS_AR7240
	select CPU_MIPSEB
	select GENERIC_UDELAY
	select HAVE_MONOTONIC_TIMER
	select HAVE_UART_SPECIAL
	select GENERIC_GPIO_LIB
	bool

if CPU_ATHEROS_AR7240

config BOOTBLOCK_CPU_INIT
	string
	default "soc/atheros/ar7240/bootblock.c"

config CONSOLE_SERIAL_UART_ADDRESS
        hex
        depends on DRIVERS_UART
        default 0xB8020000

endif
```
